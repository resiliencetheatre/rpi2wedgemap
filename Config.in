## Config.in
```kconfig
source "$BR2_EXTERNAL_rpi2wedgemap_PATH/package/libnitrokey/Config.in"
source "$BR2_EXTERNAL_rpi2wedgemap_PATH/package/nkmacsec/Config.in"
source "$BR2_EXTERNAL_rpi2wedgemap_PATH/package/python-argparse/Config.in"
source "$BR2_EXTERNAL_rpi2wedgemap_PATH/package/python-dateutils/Config.in"
source "$BR2_EXTERNAL_rpi2wedgemap_PATH/package/python-taky/Config.in"
source "$BR2_EXTERNAL_rpi2wedgemap_PATH/package/python-epdlibrary/Config.in"
source "$BR2_EXTERNAL_rpi2wedgemap_PATH/package/gwsocket/Config.in"
source "$BR2_EXTERNAL_rpi2wedgemap_PATH/package/highrate/Config.in"
source "$BR2_EXTERNAL_rpi2wedgemap_PATH/package/curlcot/Config.in"
source "$BR2_EXTERNAL_rpi2wedgemap_PATH/package/cotsim/Config.in"
source "$BR2_EXTERNAL_rpi2wedgemap_PATH/package/tacmsgrouter/Config.in"
source "$BR2_EXTERNAL_rpi2wedgemap_PATH/package/rpiboot/Config.in"
source "$BR2_EXTERNAL_rpi2wedgemap_PATH/package/audioreceiver/Config.in"
source "$BR2_EXTERNAL_rpi2wedgemap_PATH/package/audiostreamer/Config.in"
source "$BR2_EXTERNAL_rpi2wedgemap_PATH/package/modmodem/Config.in"
source "$BR2_EXTERNAL_rpi2wedgemap_PATH/package/udp2raw/Config.in"
source "$BR2_EXTERNAL_rpi2wedgemap_PATH/package/rtptun/Config.in"
source "$BR2_EXTERNAL_rpi2wedgemap_PATH/package/udpspeeder/Config.in"
source "$BR2_EXTERNAL_rpi2wedgemap_PATH/package/udptunnel/Config.in"
source "$BR2_EXTERNAL_rpi2wedgemap_PATH/package/coturn/Config.in"
source "$BR2_EXTERNAL_rpi2wedgemap_PATH/package/gsocket/Config.in"
source "$BR2_EXTERNAL_rpi2wedgemap_PATH/package/libblinkstick/Config.in"
source "$BR2_EXTERNAL_rpi2wedgemap_PATH/package/samplicator/Config.in"
source "$BR2_EXTERNAL_rpi2wedgemap_PATH/package/pttcomm/Config.in"
source "$BR2_EXTERNAL_rpi2wedgemap_PATH/package/udpproxy/Config.in"
source "$BR2_EXTERNAL_rpi2wedgemap_PATH/package/netmon/Config.in"
source "$BR2_EXTERNAL_rpi2wedgemap_PATH/package/epaperc/Config.in"
source "$BR2_EXTERNAL_rpi2wedgemap_PATH/package/liblg/Config.in"
source "$BR2_EXTERNAL_rpi2wedgemap_PATH/package/python-meshtastic/Config.in"
source "$BR2_EXTERNAL_rpi2wedgemap_PATH/package/python-pubsub/Config.in"
source "$BR2_EXTERNAL_rpi2wedgemap_PATH/package/python-dotmap/Config.in"
source "$BR2_EXTERNAL_rpi2wedgemap_PATH/package/python-tabulate/Config.in"
source "$BR2_EXTERNAL_rpi2wedgemap_PATH/package/python-timeago/Config.in"
source "$BR2_EXTERNAL_rpi2wedgemap_PATH/package/python-twine/Config.in"
source "$BR2_EXTERNAL_rpi2wedgemap_PATH/package/python-autopep8/Config.in"
source "$BR2_EXTERNAL_rpi2wedgemap_PATH/package/python-pylint/Config.in"
source "$BR2_EXTERNAL_rpi2wedgemap_PATH/package/python-pytestcov/Config.in"
source "$BR2_EXTERNAL_rpi2wedgemap_PATH/package/python-pytap2/Config.in"
source "$BR2_EXTERNAL_rpi2wedgemap_PATH/package/python-pdoc3/Config.in"
```

## configs/rpi2w_edgemap_waveshare_6.14_defconfig
```kconfig
BR2_arm=y
BR2_cortex_a53=y
BR2_ARM_FPU_NEON_VFPV4=y
BR2_PACKAGE_HOST_LINUX_HEADERS_CUSTOM_6_13=y
BR2_TOOLCHAIN_BUILDROOT_CXX=y
BR2_TOOLCHAIN_GLIBC_GCONV_LIBS_COPY=y
BR2_TARGET_GENERIC_HOSTNAME="edgemap"
BR2_TARGET_GENERIC_ISSUE="Welcome to Edgemap"
BR2_INIT_SYSTEMD=y
BR2_TARGET_GENERIC_ROOT_PASSWD="edgemap"
BR2_SYSTEM_DEFAULT_PATH="/bin:/sbin:/usr/bin:/usr/sbin"
BR2_ROOTFS_OVERLAY="${BR2_EXTERNAL}/board/raspberrypizero2w/fs_edgemap"
BR2_ROOTFS_POST_BUILD_SCRIPT="${BR2_EXTERNAL}/board/raspberrypizero2w/post-build.sh"
BR2_ROOTFS_POST_IMAGE_SCRIPT="${BR2_EXTERNAL}/board/raspberrypizero2w/post-image.sh"
BR2_LINUX_KERNEL=y
BR2_LINUX_KERNEL_CUSTOM_TARBALL=y
BR2_LINUX_KERNEL_CUSTOM_TARBALL_LOCATION="$(call github,raspberrypi,linux,045df1aadd268f4209edeb54590add85f5f6918c)/linux-045df1aadd268f4209edeb54590add85f5f6918c.tar.gz"
BR2_LINUX_KERNEL_USE_CUSTOM_CONFIG=y
BR2_LINUX_KERNEL_CUSTOM_CONFIG_FILE="${BR2_EXTERNAL}/profiles/kernel/rpi2w_std.config"
BR2_LINUX_KERNEL_DTS_SUPPORT=y
BR2_LINUX_KERNEL_INTREE_DTS_NAME="broadcom/bcm2710-rpi-zero-2-w"
BR2_LINUX_KERNEL_CUSTOM_DTS_PATH="${BR2_EXTERNAL}/profiles/kernel/ptt_keys.dts ${BR2_EXTERNAL}/profiles/kernel/ptt_codec_zero.dts"
BR2_LINUX_KERNEL_NEEDS_HOST_OPENSSL=y
BR2_PACKAGE_XZ=y
BR2_PACKAGE_E2FSPROGS=y
BR2_PACKAGE_E2FSPROGS_RESIZE2FS=y
BR2_PACKAGE_BRCMFMAC_SDIO_FIRMWARE_RPI=y
BR2_PACKAGE_BRCMFMAC_SDIO_FIRMWARE_RPI_BT=y
BR2_PACKAGE_BRCMFMAC_SDIO_FIRMWARE_RPI_WIFI=y
BR2_PACKAGE_LINUX_FIRMWARE=y
BR2_PACKAGE_RPI_FIRMWARE=y
BR2_PACKAGE_RPI_FIRMWARE_BOOTCODE_BIN=y
BR2_PACKAGE_RPI_FIRMWARE_VARIANT_PI=y
BR2_PACKAGE_RPI_FIRMWARE_CONFIG_FILE="${BR2_EXTERNAL}/board/raspberrypizero2w/config_zero2w.txt"
BR2_PACKAGE_RPI_FIRMWARE_CMDLINE_FILE="${BR2_EXTERNAL}/board/raspberrypizero2w/cmdline.txt"
BR2_PACKAGE_CRYPTSETUP=y
BR2_PACKAGE_GPSD=y
BR2_PACKAGE_GPSD_DEVICES="/dev/ttyUSB1"
BR2_PACKAGE_GPSD_ASHTECH=y
BR2_PACKAGE_GPSD_EARTHMATE=y
BR2_PACKAGE_GPSD_EVERMORE=y
BR2_PACKAGE_GPSD_FURY=y
BR2_PACKAGE_GPSD_FV18=y
BR2_PACKAGE_GPSD_GARMIN=y
BR2_PACKAGE_GPSD_GARMIN_SIMPLE_TXT=y
BR2_PACKAGE_GPSD_GEOSTAR=y
BR2_PACKAGE_GPSD_GPSCLOCK=y
BR2_PACKAGE_GPSD_GREIS=y
BR2_PACKAGE_GPSD_ISYNC=y
BR2_PACKAGE_GPSD_ITRAX=y
BR2_PACKAGE_GPSD_NMEA2000=y
BR2_PACKAGE_GPSD_OCEANSERVER=y
BR2_PACKAGE_GPSD_ONCORE=y
BR2_PACKAGE_GPSD_RTCM104V2=y
BR2_PACKAGE_GPSD_RTCM104V3=y
BR2_PACKAGE_GPSD_SIRF=y
BR2_PACKAGE_GPSD_SKYTRAQ=y
BR2_PACKAGE_GPSD_SUPERSTAR2=y
BR2_PACKAGE_GPSD_TRIMBLE_TSIP=y
BR2_PACKAGE_GPSD_TRIPMATE=y
BR2_PACKAGE_GPSD_TRUE_NORTH=y
BR2_PACKAGE_GPSD_UBX=y
BR2_PACKAGE_HDPARM=y
BR2_PACKAGE_PARTED=y
BR2_PACKAGE_PHP=y
BR2_PACKAGE_PHP_SAPI_APACHE=y
BR2_PACKAGE_PHP_EXT_SQLITE=y
BR2_PACKAGE_PHP_EXT_PDO=y
BR2_PACKAGE_PHP_EXT_PDO_SQLITE=y
BR2_PACKAGE_PHP_EXT_GD=y
BR2_PACKAGE_PHP_EXT_XML=y
BR2_PACKAGE_PYTHON3=y
BR2_PACKAGE_PYTHON3_PY_PYC=y
BR2_PACKAGE_PYTHON3_BZIP2=y
BR2_PACKAGE_PYTHON3_SQLITE=y
BR2_PACKAGE_PYTHON_AIOHTTP=y
BR2_PACKAGE_PYTHON_ASYNC_TIMEOUT=y
BR2_PACKAGE_PYTHON_BLEAK=y
BR2_PACKAGE_PYTHON_DATEUTIL=y
BR2_PACKAGE_PYTHON_ESPTOOL=y
BR2_PACKAGE_PYTHON_FLASK=y
BR2_PACKAGE_PYTHON_GUNICORN=y
BR2_PACKAGE_PYTHON_LXML=y
BR2_PACKAGE_PYTHON_MARKDOWN=y
BR2_PACKAGE_PYTHON_PEXPECT=y
BR2_PACKAGE_PYTHON_PIP=y
BR2_PACKAGE_PYTHON_PROTOBUF=y
BR2_PACKAGE_PYTHON_PYOPENSSL=y
BR2_PACKAGE_PYTHON_PYPARSING=y
BR2_PACKAGE_PYTHON_PYQRCODE=y
BR2_PACKAGE_PYTHON_PYTEST=y
BR2_PACKAGE_PYTHON_PYTZ=y
BR2_PACKAGE_PYTHON_QRCODE=y
BR2_PACKAGE_PYTHON_REDIS=y
BR2_PACKAGE_PYTHON_REQUESTS=y
BR2_PACKAGE_PYTHON_URWID_READLINE=y
BR2_PACKAGE_PYTHON_WEBENCODINGS=y
BR2_PACKAGE_PYTHON_WEBSOCKETS=y
BR2_PACKAGE_MINIZIP=y
BR2_PACKAGE_SNAPPY=y
BR2_PACKAGE_GNUTLS=y
BR2_PACKAGE_GNUTLS_OPENSSL=y
BR2_PACKAGE_GNUTLS_TOOLS=y
BR2_PACKAGE_LIBSODIUM=y
BR2_PACKAGE_LIBOPENSSL_BIN=y
BR2_PACKAGE_LIBCONFIG=y
BR2_PACKAGE_LIBQRENCODE=y
BR2_PACKAGE_LIBQRENCODE_TOOLS=y
BR2_PACKAGE_LIBGPIOD=y
BR2_PACKAGE_LIBGPIOD_TOOLS=y
BR2_PACKAGE_LIBGUDEV=y
BR2_PACKAGE_JANSSON=y
BR2_PACKAGE_LIBCURL=y
BR2_PACKAGE_LIBMICROHTTPD=y
BR2_PACKAGE_LIBNICE=y
BR2_PACKAGE_LIBPCAP=y
BR2_PACKAGE_LIBTIRPC=y
BR2_PACKAGE_NGHTTP2=y
BR2_PACKAGE_LIBEV=y
BR2_PACKAGE_LIBEVENT=y
BR2_PACKAGE_LIBPTHREAD_STUBS=y
BR2_PACKAGE_LIBUV=y
BR2_PACKAGE_PCRE2_16=y
BR2_PACKAGE_READLINE=y
BR2_PACKAGE_APACHE=y
BR2_PACKAGE_DNSMASQ=y
BR2_PACKAGE_HOSTAPD=y
# BR2_PACKAGE_HOSTAPD_VLAN is not set
BR2_PACKAGE_IODINE=y
BR2_PACKAGE_IPERF3=y
BR2_PACKAGE_IPROUTE2=y
BR2_PACKAGE_IW=y
BR2_PACKAGE_IWD=y
BR2_PACKAGE_NFTABLES=y
# BR2_PACKAGE_NFTABLES_PYTHON is not set
BR2_PACKAGE_OPENRESOLV=y
BR2_PACKAGE_OPENSSH=y
BR2_PACKAGE_RSYNC=y
BR2_PACKAGE_WGET=y
BR2_PACKAGE_WIREGUARD_TOOLS=y
BR2_PACKAGE_WIRELESS_TOOLS=y
BR2_PACKAGE_GNUPG2=y
BR2_PACKAGE_HTOP=y
BR2_PACKAGE_SCRUB=y
# BR2_PACKAGE_SYSTEMD_HWDB is not set
BR2_PACKAGE_SYSTEMD_RFKILL=y
BR2_PACKAGE_UTIL_LINUX_BINARIES=y
BR2_PACKAGE_UTIL_LINUX_MOUNTPOINT=y
BR2_PACKAGE_UTIL_LINUX_RFKILL=y
BR2_PACKAGE_NANO=y
BR2_TARGET_ROOTFS_EXT2=y
BR2_TARGET_ROOTFS_EXT2_4=y
BR2_TARGET_ROOTFS_EXT2_SIZE="1000M"
# BR2_TARGET_ROOTFS_TAR is not set
BR2_PACKAGE_HOST_DOSFSTOOLS=y
BR2_PACKAGE_HOST_GENIMAGE=y
BR2_PACKAGE_HOST_KMOD_XZ=y
BR2_PACKAGE_HOST_MTOOLS=y
BR2_PACKAGE_HOST_PYTHON3_BZIP2=y
BR2_PACKAGE_HOST_PYTHON3_SSL=y
BR2_PACKAGE_HOST_QEMU=y
BR2_PACKAGE_HOST_QEMU_SYSTEM_MODE=y
BR2_PACKAGE_HOST_QEMU_LINUX_USER_MODE=y
BR2_PACKAGE_GWSOCKET=y
BR2_PACKAGE_UDP2RAW=y
BR2_PACKAGE_EPAPERC=y
BR2_PACKAGE_LIBLG=y
BR2_PACKAGE_PYTHON_MESHTASTIC=y
BR2_PACKAGE_PYTHON_PUBSUB=y
BR2_PACKAGE_PYTHON_DOTMAP=y
BR2_PACKAGE_PYTHON_TABULATE=y
BR2_PACKAGE_PYTHON_TIMEAGO=y
BR2_PACKAGE_PYTHON_TWINE=y
BR2_PACKAGE_PYTHON_AUTOPEP8=y
BR2_PACKAGE_PYTHON_PYLINT=y
BR2_PACKAGE_PYTHON_PYTESTCOV=y
BR2_PACKAGE_PYTHON_PYTAP2=y
BR2_PACKAGE_GPSREADER=y
BR2_PACKAGE_PYTHON_PRINT_COLOR=y
BR2_PACKAGE_PYTHON_RNS=y
BR2_PACKAGE_PYTHON_LXMF=y
BR2_PACKAGE_PYTHON_NOMADNET=y
BR2_PACKAGE_PYTHON_PEEWEE=y
```

## configs/rpi2w_edgemap_waveshare_6.6_defconfig
```kconfig
BR2_arm=y
BR2_cortex_a53=y
BR2_ARM_FPU_NEON_VFPV4=y
BR2_PACKAGE_HOST_LINUX_HEADERS_CUSTOM_6_6=y
BR2_BINUTILS_VERSION_2_42_X=y
BR2_GCC_VERSION_13_X=y
BR2_TOOLCHAIN_BUILDROOT_CXX=y
BR2_TOOLCHAIN_GLIBC_GCONV_LIBS_COPY=y
BR2_BACKUP_SITE="http://sources.buildroot.net"
BR2_TARGET_GENERIC_HOSTNAME="edgemap"
BR2_TARGET_GENERIC_ISSUE="Welcome to Edgemap"
BR2_INIT_SYSTEMD=y
BR2_TARGET_GENERIC_ROOT_PASSWD="root"
BR2_SYSTEM_DEFAULT_PATH="/bin:/sbin:/usr/bin:/usr/sbin"
BR2_ROOTFS_OVERLAY="${BR2_EXTERNAL}/board/raspberrypizero2w/fs_edgemap"
BR2_ROOTFS_POST_BUILD_SCRIPT="${BR2_EXTERNAL}/board/raspberrypizero2w/post-build.sh"
BR2_ROOTFS_POST_IMAGE_SCRIPT="${BR2_EXTERNAL}/board/raspberrypizero2w/post-image.sh"
BR2_LINUX_KERNEL=y
BR2_LINUX_KERNEL_CUSTOM_TARBALL=y
BR2_LINUX_KERNEL_CUSTOM_TARBALL_LOCATION="$(call github,raspberrypi,linux,dd7a15472b18d4bce738bb9213443c140473833b)/linux-dd7a15472b18d4bce738bb9213443c140473833b.tar.gz"
BR2_LINUX_KERNEL_USE_CUSTOM_CONFIG=y
BR2_LINUX_KERNEL_CUSTOM_CONFIG_FILE="${BR2_EXTERNAL}/profiles/kernel/rpi2w_tiny.config"
BR2_LINUX_KERNEL_DTS_SUPPORT=y
BR2_LINUX_KERNEL_INTREE_DTS_NAME="broadcom/bcm2710-rpi-zero-2-w"
BR2_LINUX_KERNEL_CUSTOM_DTS_PATH="${BR2_EXTERNAL}/profiles/kernel/ptt_keys.dts ${BR2_EXTERNAL}/profiles/kernel/ptt_codec_zero.dts"
BR2_LINUX_KERNEL_NEEDS_HOST_OPENSSL=y
BR2_PACKAGE_XZ=y
BR2_PACKAGE_E2FSPROGS=y
BR2_PACKAGE_E2FSPROGS_RESIZE2FS=y
BR2_PACKAGE_BRCMFMAC_SDIO_FIRMWARE_RPI=y
BR2_PACKAGE_BRCMFMAC_SDIO_FIRMWARE_RPI_BT=y
BR2_PACKAGE_BRCMFMAC_SDIO_FIRMWARE_RPI_WIFI=y
BR2_PACKAGE_LINUX_FIRMWARE=y
BR2_PACKAGE_RPI_FIRMWARE=y
BR2_PACKAGE_RPI_FIRMWARE_BOOTCODE_BIN=y
BR2_PACKAGE_RPI_FIRMWARE_VARIANT_PI=y
BR2_PACKAGE_RPI_FIRMWARE_CONFIG_FILE="${BR2_EXTERNAL}/board/raspberrypizero2w/config_zero2w.txt"
BR2_PACKAGE_RPI_FIRMWARE_CMDLINE_FILE="${BR2_EXTERNAL}/board/raspberrypizero2w/cmdline.txt"
BR2_PACKAGE_CRYPTSETUP=y
BR2_PACKAGE_HDPARM=y
BR2_PACKAGE_PARTED=y
BR2_PACKAGE_PHP=y
BR2_PACKAGE_PHP_SAPI_APACHE=y
BR2_PACKAGE_PHP_EXT_SQLITE=y
BR2_PACKAGE_PHP_EXT_PDO=y
BR2_PACKAGE_PHP_EXT_PDO_SQLITE=y
BR2_PACKAGE_PHP_EXT_GD=y
BR2_PACKAGE_PHP_EXT_XML=y
BR2_PACKAGE_PYTHON3=y
BR2_PACKAGE_PYTHON_BLEAK=y
BR2_PACKAGE_PYTHON_CRYPTOGRAPHY=y
BR2_PACKAGE_PYTHON_DATEUTIL=y
BR2_PACKAGE_PYTHON_GPIOZERO=y
BR2_PACKAGE_PYTHON_MARKDOWN=y
BR2_PACKAGE_PYTHON_NUMPY=y
BR2_PACKAGE_PYTHON_PEXPECT=y
BR2_PACKAGE_PYTHON_PILLOW=y
BR2_PACKAGE_PYTHON_PROTOBUF=y
BR2_PACKAGE_PYTHON_PYPARSING=y
BR2_PACKAGE_PYTHON_PYQRCODE=y
BR2_PACKAGE_PYTHON_PYTEST=y
BR2_PACKAGE_PYTHON_PYYAML=y
BR2_PACKAGE_PYTHON_QRCODE=y
BR2_PACKAGE_PYTHON_REQUESTS=y
BR2_PACKAGE_PYTHON_SERIAL=y
BR2_PACKAGE_PYTHON_SMBUS_CFFI=y
BR2_PACKAGE_PYTHON_SPIDEV=y
BR2_PACKAGE_LIBGCRYPT=y
BR2_PACKAGE_LIBSODIUM=y
BR2_PACKAGE_LIBOPENSSL_BIN=y
# BR2_PACKAGE_LIBOPENSSL_ENABLE_WEAK_SSL is not set
BR2_PACKAGE_SQLITE_ENABLE_JSON1=y
BR2_PACKAGE_LIBCONFIG=y
BR2_PACKAGE_LIBGPIOD=y
BR2_PACKAGE_LIBGPIOD_TOOLS=y
BR2_PACKAGE_LIBGUDEV=y
BR2_PACKAGE_JANSSON=y
BR2_PACKAGE_LIBXSLT=y
BR2_PACKAGE_LIBPCAP=y
BR2_PACKAGE_LIBTIRPC=y
BR2_PACKAGE_NGHTTP2=y
BR2_PACKAGE_LIBEV=y
BR2_PACKAGE_LIBEVENT=y
BR2_PACKAGE_LIBPTHREAD_STUBS=y
BR2_PACKAGE_LIBUV=y
BR2_PACKAGE_PCRE2_16=y
BR2_PACKAGE_READLINE=y
BR2_PACKAGE_APACHE=y
BR2_PACKAGE_DROPBEAR=y
BR2_PACKAGE_HOSTAPD=y
# BR2_PACKAGE_HOSTAPD_VLAN is not set
BR2_PACKAGE_IPROUTE2=y
BR2_PACKAGE_IW=y
BR2_PACKAGE_IWD=y
BR2_PACKAGE_NFTABLES=y
# BR2_PACKAGE_NFTABLES_PYTHON is not set
BR2_PACKAGE_OPENRESOLV=y
BR2_PACKAGE_WIREGUARD_TOOLS=y
# BR2_PACKAGE_SYSTEMD_HWDB is not set
BR2_PACKAGE_UTIL_LINUX_BINARIES=y
BR2_PACKAGE_UTIL_LINUX_MOUNTPOINT=y
BR2_PACKAGE_NANO=y
BR2_TARGET_ROOTFS_EXT2=y
BR2_TARGET_ROOTFS_EXT2_4=y
BR2_TARGET_ROOTFS_EXT2_SIZE="230M"
BR2_TARGET_ROOTFS_INITRAMFS=y
# BR2_TARGET_ROOTFS_TAR is not set
BR2_PACKAGE_HOST_DOSFSTOOLS=y
BR2_PACKAGE_HOST_GENIMAGE=y
BR2_PACKAGE_HOST_KMOD_XZ=y
BR2_PACKAGE_HOST_MTOOLS=y
BR2_PACKAGE_HOST_PYTHON3=y
BR2_PACKAGE_HOST_PYTHON3_BZIP2=y
BR2_PACKAGE_HOST_PYTHON3_SSL=y
BR2_PACKAGE_HOST_QEMU=y
BR2_PACKAGE_HOST_QEMU_SYSTEM_MODE=y
BR2_PACKAGE_HOST_QEMU_LINUX_USER_MODE=y
BR2_PACKAGE_GWSOCKET=y
BR2_PACKAGE_UDP2RAW=y
BR2_PACKAGE_EPAPERC=y
BR2_PACKAGE_LIBLG=y
BR2_PACKAGE_PYTHON_MESHTASTIC=y
BR2_PACKAGE_PYTHON_PUBSUB=y
BR2_PACKAGE_PYTHON_DOTMAP=y
BR2_PACKAGE_PYTHON_TABULATE=y
BR2_PACKAGE_PYTHON_TIMEAGO=y
BR2_PACKAGE_PYTHON_TWINE=y
BR2_PACKAGE_PYTHON_AUTOPEP8=y
BR2_PACKAGE_PYTHON_PYLINT=y
BR2_PACKAGE_PYTHON_PYTESTCOV=y
BR2_PACKAGE_PYTHON_PYTAP2=y
```

## package/epaperc/Config.in
```kconfig
config BR2_PACKAGE_EPAPERC
        bool "epaperc"
        help 
              epaper binary
```

## package/python-epdlibrary/Config.in
```kconfig
config BR2_PACKAGE_PYTHON_EPDLIBRARY
	bool "python-epdlibrary"
	help
	  e-paper for raspberry pi (Waveshare e-paper)

	  https://github.com/soonuse/epd-library-python
```
